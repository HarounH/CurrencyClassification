#include <SPI.h>
#include <SD.h>
#include <String.h>
#include <math.h>
#include <avr/pgmspace.h>
#include <SoftwareSerial.h>

#define FLASH 1
/* SD card attached to SPI bus as follows:
 ** MOSI - pin 11
 ** MISO - pin 12
 ** CLK - pin 13
 ** CS - pin 4
*/

const char datasetName[20] = "usps2.txt";

#if FLASH
 
  const int M PROGMEM =4;
  const int D PROGMEM =257;
  const int model[4369] PROGMEM ={13,-8,5,3,0,4,-1,-0,-0,0,-1,-0,-0,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-60,788};
 
#else
  
  const int M  =4;
  const int D  =257;
  const int model[4369]  ={13,-8,5,3,0,4,-1,-0,-0,0,-1,-0,-0,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-60,788};
 
#endif

int tanh_INT(long val){
  int scale = 1000;
  if(val >= scale) 
    return scale;
  if(val <= -scale)
    return -scale; 
  return val - (0.001*val)*(0.001*val)*val*0.33;
}

void computeZ_X(double *Z_X, int test, int ind, int numVec){
  int count=0;
  for(int zp=ind*numVec ; zp < (ind+1)*numVec ; zp++){
    int zval;
    #if FLASH
      zval = pgm_read_word_near(&(model[zp]));
    #else
      zval = model[zp];
    #endif
    Z_X[count] += test * double(zval);
    count++;
  }
}

void setup() {
  // put your setup code here, to run once:
  pinMode(8, OUTPUT);
  Serial.begin(9600);
  
  Serial.print(F("Initializing SD card..."));
  if (!SD.begin(4)) {
    Serial.println(F("initialization failed!"));
    return;
  }
  Serial.println(F("initialization done."));
}

void loop() {
  // put your main code here, to run repeatedly:
  if(Serial.available()==0){

    unsigned long count = 0;
    unsigned int repeat = 1;
    unsigned long time1,time2=0;
    unsigned long Correct=0; 
    int dim,numLeaf;
    #if FLASH
      dim=pgm_read_word_near(&D);
      numLeaf=pgm_read_word_near(&M);
    #else
      dim=D;
      numLeaf=M;
    #endif
    
    for(unsigned int itr=0;itr<repeat;itr++){

      String str="";
      bool labelFlag=1;
      int ind=0,testY;
      int numVec = 2*(2*numLeaf-1) + numLeaf-1;

      double *Z_X = new double[numVec];
      for(int p=0;p<numVec;p++)
        Z_X[p] = 0.0; 
        
      // Open the test data file for prediction
      File myFile = SD.open(datasetName);
      /*if (myFile)
        Serial.println(F("Opening Test data file:"));
      else 
        Serial.println(F("Error opening Test file"));
      */
      // read from the file until there's nothing else in it:
      while (myFile.available()){
        char c = myFile.read();
        if(c != '/' && c != ',')  
          str += c;
        else if(c == '/' || c == ','){
          if(labelFlag==1){
            testY = str.toInt();
            labelFlag=0;
          }else{ 
            int testX = 10*str.toFloat();
            //time1 = micros();
            if(testX != 0)
              computeZ_X(Z_X, testX, ind, numVec);
            //time2 += micros() - time1;
            ind++;
          }
          str="";
          
          if(c == '/'){
            count++;
            ind=0; labelFlag=1;

            // Start Time
            time1 = micros();
            int curr = 0;
            double Score = 0.0;
            while(curr < numLeaf-1){
              Score += tanh_INT(Z_X[curr+2*numLeaf-1]) * Z_X[curr];
              long tt = Z_X[curr+2*(2*numLeaf-1)];
              curr = (tt>0) ? 2*curr+1 : 2*curr+2;
            }
            Score += tanh_INT(Z_X[curr+2*numLeaf-1]) * Z_X[curr];
            if(testY*Score>0)
              Correct++;

            // End Time
            time2 += micros() - time1; 
            
            for(int p=0;p<numVec;p++)
              Z_X[p] = 0; 
          }
        }
      }
      delete [] Z_X;
      myFile.close();
    }
    Serial.println(F("Accuracy : "));
    Serial.println(Correct*100/count);
    Serial.println(F("Time  : "));
    Serial.println((float)time2/count+dim*4);
  }
}
